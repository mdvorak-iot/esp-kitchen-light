## main/Kconfig.projbuild
```kconfig
menu "Application config"
    config APP_SWITCH_AUTO_OFF_SEC
        int "Auto power-off for switch (sec)"
        default 3600

    config APP_MOTION_AUTO_OFF_SEC
        int "Auto power-off for sensor (sec)"
        default 120

    config APP_PWM_FADE_STEP
        int "Fade step for pwm animation"
        default 6

    config APP_SWITCH_DEBOUNCE_MS
        int "Switch debounce interval (ms)"
        default 200

    config APP_SWITCH_FORCE_OFF_SEC
        int "Switch force power-off (sec)"
        default 30
endmenu

menu "Hardware config"
    config HW_PWM_PIN
        int "PWM PIN"
        default 23

    config HW_PWM_INVERTED
        bool "PWM inverted duty cycle"
        default y
        help
            When true, zero duty cycle means full power.

    config HW_PWM_FREQUENCY
        int "PWM frequency"
        default 75000
        help
            Must be in limit set by a resolution.

    config HW_PWM_RESOLUTION
        int "PWM resolution, in bits"
        default 10

    config HW_SWITCH_PIN
        int "Manual switch PIN"
        default 2

    config HW_MOTION_OUTPUT_PIN
        int "RCWL-0516 output PIN"
        default 17

    config HW_MOTION_CDS_PIN
        int "RCWL-0516 CDS PIN"
        default 5
endmenu
```
